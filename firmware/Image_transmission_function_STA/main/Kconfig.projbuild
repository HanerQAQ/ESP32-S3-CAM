## firmware/Image_transmission_function_STA/main/Kconfig.projbuild
```kconfig
menu "ESP32-S3-CAM Wi-Fi Provisioning"

    config EXAMPLE_WIFI_AP_CHANNEL
        int "SoftAP provisioning channel (2.4 GHz)"
        default 1
        range 1 13
        help
            Fixed 2.4 GHz channel for the SoftAP provisioning hotspot.
            Channel 1 keeps boot deterministic and matches the P4C5/S3 reference.
            When the STA connects, the SoftAP follows the router channel so the
            single-radio S3 can run APSTA on one shared channel.

    config EXAMPLE_WIFI_AP_MAX_CONNECTIONS
        int "Wi-Fi AP max connections"
        default 4
        range 1 10
        help
            Maximum number of stations allowed to connect to the SoftAP.

endmenu
```

## firmware/Image_transmission_function_STA/sdkconfig.defaults
```kconfig
CONFIG_IDF_TARGET="esp32s3"

CONFIG_ESP_DEFAULT_CPU_FREQ_MHZ_240=y
CONFIG_SPIRAM=y

CONFIG_ESP32S3_DATA_CACHE_64KB=y
CONFIG_ESP32S3_DATA_CACHE_8WAYS=y

CONFIG_ESPTOOLPY_FLASHSIZE_8MB=y

CONFIG_ESPTOOLPY_FLASHFREQ_80M=y
CONFIG_ESPTOOLPY_FLASHMODE_DIO=y

# PSRAM 40 MHz keeps GC2145 DMA stable while Wi-Fi STA is associated
CONFIG_SPIRAM_SPEED_40M=y

CONFIG_ESP_WIFI_SSID="Hello"
CONFIG_ESP_WIFI_PASSWORD="12345678"

CONFIG_SERVER_IP="192.168.4.1"
CONFIG_ESP_WIFI_AP_SSID="ESP32-S3-CAM-WIFI"
#CONFIG_ESP_WIFI_AP_PASSWORD="12345678"

# CONFIG_ESP_TASK_WDT_INIT is not set

# Wait for esp-idf stable
CONFIG_BOOTLOADER_COMPILER_OPTIMIZATION_PERF=y
CONFIG_BOOTLOADER_LOG_LEVEL_INFO=y
# CONFIG_BOOTLOADER_WDT_ENABLE is not set
CONFIG_SPIRAM_MEMTEST=n

# http_server
CONFIG_HTTPD_MAX_REQ_HDR_LEN=2048
CONFIG_HTTPD_MAX_URI_LEN=2048
CONFIG_HTTPD_WS_SUPPORT=y

CONFIG_PARTITION_TABLE_CUSTOM=y
CONFIG_PARTITION_TABLE_CUSTOM_FILENAME="partitions.csv"

CONFIG_LWIP_MAX_SOCKETS=16

#
# SPI RAM config
#
# CONFIG_SPIRAM_MODE_QUAD is not set
CONFIG_SPIRAM_MODE_OCT=y
CONFIG_SPIRAM_TYPE_AUTO=y
CONFIG_FREERTOS_TASK_CREATE_ALLOW_EXT_MEM=y
CONFIG_SPIRAM_CLK_IO=30
CONFIG_SPIRAM_CS_IO=26
CONFIG_SPIRAM_SPEED=40
CONFIG_SPIRAM_BOOT_INIT=y
CONFIG_SPIRAM_USE_MALLOC=y
CONFIG_SPIRAM_MALLOC_ALWAYSINTERNAL=16384
CONFIG_SPIRAM_MALLOC_RESERVE_INTERNAL=32768

CONFIG_CAMERA_MODULE_ESP_S3_EYE=y
CONFIG_ESPTOOLPY_NO_STUB=y
CONFIG_ESP_CONSOLE_UART_DEFAULT=y
CONFIG_ESP_CONSOLE_SECONDARY_NONE=y

# IPv4-only: avoid unreachable mDNS AAAA records
# CONFIG_LWIP_IPV6 is not set

# Keep mDNS responsive while camera streaming is busy
CONFIG_MDNS_TASK_PRIORITY=4

# Wi-Fi provisioning
CONFIG_EXAMPLE_WIFI_AP_CHANNEL=1
CONFIG_EXAMPLE_WIFI_AP_MAX_CONNECTIONS=4

CONFIG_ESP32S3_DATA_CACHE_LINE_32B=y

#
# SPI RAM config
#
# end of SPI RAM config


# Keep legacy I2C slave API active cleanly in IDF 6.1
CONFIG_I2C_SUPPRESS_DEPRECATE_WARN=y

# Keep -O2 performance optimization (matches original S3CAM sdkconfig)
CONFIG_COMPILER_OPTIMIZATION_PERF=y
```
